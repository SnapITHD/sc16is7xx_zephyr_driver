## drivers/serial/Kconfig
```kconfig
# Copyright 2021 The Chromium OS Authors
#
# SPDX-License-Identifier: Apache-2.0
menu "SC16IS7XX UART"
config SC16IS7XX
	bool "SC16IS7XX Dual UART"
	default y
	depends on DT_HAS_NXP_SC16IS7XX_ENABLED
	select I2C
	help
	  Enable driver for SC16IS7XX Dual UART.

config SC16IS7XX_INTERRUPT_DRIVEN
	depends on SC16IS7XX
	bool "SC16IS7XX Interrupt Driven"
	default y
	help 
		Enable interrupt driven functionality on the 
		SC16IS7XX Device


# for logging levels		
module = SC16IS7XX
module-str =sc16is7xx i2c uart
source "subsys/logging/Kconfig.template.log_config"


endmenu
```

## dts/bindings/i2c/nxp,sc16is7xx.yaml
```yaml
description: Opito SC16IS7xx I2C DUAL UART

compatible: "nxp,sc16is7xx"

include: [i2c-device.yaml]

properties:
  reg:
    required: true

  clock-frequency:
    type: int
    required: true
    description: |
      Crystal/clock frequency in Hz. Common values are 1843200 or 14745600.

  spr:
    type: int
    required: false
    description: |
      Value of the SPR register

  interrupt-gpios:
    type: phandle-array
    required: false
    description: Interrupt GPIO pin (active-low open-drain)

  num-ports:
    type: int
    required: true
    description: |
      Number of serial ports on this device.

child-binding:
  include: [uart-controller.yaml]

  description: UART device over SC16IS7XX IC

  properties:
    "#address-cells":
      required: true
      const: 1
    "#size-cells":
      required: true
      const: 0

    reg:
      required: true

    spr:
      type: int
      required: false
      description: |
        Value of the SPR register

    serial-mode:
      required: false
      type: string
      description: |
        Configures the GPIO for the electrical interface selected
        Default to RS232 if not specified.
      enum:
        - "rs232"
        - "rs485"
        - "rs422"
      default: "rs232"
```

## dts/bindings/serial/nxp,sc16is7xx-serial.yaml
```yaml
description: Opito SC16IS7xx I2C DUAL UART

compatible: "nxp,sc16is7xx-serial"

include: [uart-controller.yaml]

properties:
  reg:
    required: true

  spr:
    type: int
    required: false
    description: |
      Value of the SPR register

  serial-mode:
    required: false
    type: string
    description: |
      Configures the GPIO for the electrical interface selected
      Default to RS232 if not specified.
    enum:
      - "rs232"
      - "rs485"
      - "rs422"
    default: "rs232"
```
